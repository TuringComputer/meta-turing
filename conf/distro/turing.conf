## conf/distro/turing.conf
```bitbake
DISTRO = "turing"
DISTRO_NAME = "Turing Computer (Yocto Project Reference Distribution)"
DISTRO_VERSION = "2.1.1"
DISTRO_CODENAME = "krogoth"
SDK_VENDOR = "-turingsdk"
SDK_VERSION := "${@'${DISTRO_VERSION}'.replace('snapshot-${DATE}','snapshot')}"

MAINTAINER = "Turing Computer <www.turingcomputer.com.br>"

TARGET_VENDOR = "-turing"

LOCALCONF_VERSION = "1"

TURING_DEFAULT_DISTRO_FEATURES = "alsa \
							      argp \
							      bluetooth \
							      ext2 \
							      irda \
							      largefile \
							      pcmcia \
							      usbgadget \
							      usbhost \
							      wifi \
							      xattr \
							      nfs \
							      zeroconf \
							      pci \
							      3g \
							      nfc \
							      opengl \
							      ptest \
							      multiarch \
							      systemd \
							      ppp \
							      x11 \
							      wayland \
							      "
TURING_DEFAULT_EXTRA_RDEPENDS = "packagegroup-core-boot"
TURING_DEFAULT_EXTRA_RRECOMMENDS = "kernel-module-af-packet"

DISTRO_FEATURES ?= "${TURING_DEFAULT_DISTRO_FEATURES} ${DISTRO_FEATURES_LIBC}"

VIRTUAL-RUNTIME_init_manager = "systemd"
DISTRO_FEATURES_BACKFILL_CONSIDERED = "sysvinit"
VIRTUAL-RUNTIME_initscripts = ""

PREFERRED_VERSION_linux-yocto ?= "4.4%"
PREFERRED_VERSION_linux-yocto_qemux86 ?= "4.4%"
PREFERRED_VERSION_linux-yocto_qemux86-64 ?= "4.4%"
PREFERRED_VERSION_linux-yocto_qemuarm ?= "4.4%"
PREFERRED_VERSION_linux-yocto_qemumips ?= "4.4%"
PREFERRED_VERSION_linux-yocto_qemumips64 ?= "4.4%"
PREFERRED_VERSION_linux-yocto_qemuppc ?= "4.4%"

SDK_NAME = "${DISTRO}-${TCLIBC}-${SDK_ARCH}-${IMAGE_BASENAME}-${TUNE_PKGARCH}"
SDKPATH = "/opt/${DISTRO}/${SDK_VERSION}"

DISTRO_EXTRA_RDEPENDS += " ${TURING_DEFAULT_EXTRA_RDEPENDS}"
DISTRO_EXTRA_RRECOMMENDS += " ${TURING_DEFAULT_EXTRA_RRECOMMENDS}"

TURINGQEMUDEPS = "${@bb.utils.contains("INCOMPATIBLE_LICENSE", "GPL-3.0", "", "packagegroup-core-device-devel",d)}"
DISTRO_EXTRA_RDEPENDS_append_qemuarm = " ${TURINGQEMUDEPS}"
DISTRO_EXTRA_RDEPENDS_append_qemuarm64 = " ${TURINGQEMUDEPS}"
DISTRO_EXTRA_RDEPENDS_append_qemumips = " ${TURINGQEMUDEPS}"
DISTRO_EXTRA_RDEPENDS_append_qemuppc = " ${TURINGQEMUDEPS}"
DISTRO_EXTRA_RDEPENDS_append_qemux86 = " ${TURINGQEMUDEPS}"
DISTRO_EXTRA_RDEPENDS_append_qemux86-64 = " ${TURINGQEMUDEPS}"

TCLIBCAPPEND = ""

QEMU_TARGETS ?= "arm aarch64 i386 mips mipsel mips64 ppc x86_64"
# Other QEMU_TARGETS "mips64el sh4"

PREMIRRORS ??= "\
bzr://.*/.*   http://downloads.yoctoproject.org/mirror/sources/ \n \
cvs://.*/.*   http://downloads.yoctoproject.org/mirror/sources/ \n \
git://.*/.*   http://downloads.yoctoproject.org/mirror/sources/ \n \
gitsm://.*/.* http://downloads.yoctoproject.org/mirror/sources/ \n \
hg://.*/.*    http://downloads.yoctoproject.org/mirror/sources/ \n \
osc://.*/.*   http://downloads.yoctoproject.org/mirror/sources/ \n \
p4://.*/.*    http://downloads.yoctoproject.org/mirror/sources/ \n \
svn://.*/.*   http://downloads.yoctoproject.org/mirror/sources/ \n"

MIRRORS =+ "\
ftp://.*/.*      http://downloads.yoctoproject.org/mirror/sources/ \n \
http://.*/.*     http://downloads.yoctoproject.org/mirror/sources/ \n \
https://.*/.*    http://downloads.yoctoproject.org/mirror/sources/ \n"

# The CONNECTIVITY_CHECK_URI's are used to test whether we can succesfully
# fetch from the network (and warn you if not). To disable the test set
# the variable to be empty.
# Git example url: git://git.yoctoproject.org/yocto-firewall-test;protocol=git;rev=master
CONNECTIVITY_CHECK_URIS ?= "https://www.example.com/"

SANITY_TESTED_DISTROS ?= " \
            poky-1.7 \n \
            poky-1.8 \n \
            poky-2.0 \n \
            Ubuntu-14.04 \n \
            Ubuntu-14.10 \n \
            Ubuntu-15.04 \n \
            Ubuntu-15.10 \n \
            Fedora-21 \n \
            Fedora-22 \n \
            Fedora-23 \n \
            CentOS-6.* \n \
            CentOS-7.* \n \
            Debian-7.* \n \
            Debian-8.* \n \
            openSUSE-project-13.2 \n \
            "
#
# OELAYOUT_ABI allows us to notify users when the format of TMPDIR changes in 
# an incompatible way. Such changes should usually be detailed in the commit
# that breaks the format and have been previously discussed on the mailing list 
# with general agreement from the core team.
#
OELAYOUT_ABI = "11"

# add poky sanity bbclass
INHERIT += "poky-sanity"

# QA check settings - a little stricter than the OE-Core defaults
WARN_TO_ERROR_QA = "already-stripped compile-host-path install-host-path \
                    installed-vs-shipped ldflags pn-overrides rpaths staticdev \
                    useless-rpaths"
WARN_QA_remove = "${WARN_TO_ERROR_QA}"
ERROR_QA_append = " ${WARN_TO_ERROR_QA}"

require conf/distro/include/poky-world-exclude.inc
require conf/distro/include/no-static-libs.inc
require conf/distro/include/yocto-uninative.inc
INHERIT += "uninative"
```

## conf/layer.conf
```bitbake
# We have a conf and classes directory, add to BBPATH
BBPATH .= ":${LAYERDIR}"

# We have a packages directory, add to BBFILES
BBFILES += "${LAYERDIR}/recipes-*/*/*.bb \
            ${LAYERDIR}/recipes-*/*/*.bbappend"

BBFILE_COLLECTIONS += "turing"
BBFILE_PATTERN_turing:= "^${LAYERDIR}/"
BBFILE_PRIORITY_turing = "8"

#LAYERDEPENDS_turing = "core fsl-arm"
LICENSE_PATH += "${LAYERDIR}/licenses"
```

## conf/machine/imx6ul-turing.conf
```bitbake
#@TYPE: Machine
#@NAME: Turing i.MX6UL Evaluation Board
#@SOC: i.MX6 UL
#@DESCRIPTION: Machine configuration for Turing Computer i.MX6 Evaluation Boards
#@MAINTAINER: Mauricio Cirelli <mauricio@turingcomputer.com.br>

# Machine config for the Turing Computer i.MX6UL Evaluation Board machines.
# They all use the same machine config, since the u-boot SPL autodetects the
# machine type upon booting. SOC_FAMILY includes all SoCs from all of these machines
# to let recipes include firmware etc. for all of these SoCs.

require conf/machine/include/imx-base.inc
require conf/machine/include/tune-cortexa7.inc

IMAGE_FSTYPES = "sdcard.gz ubi"

SOC_FAMILY = "mx6:mx6ul:"
MACHINEOVERRIDES =. "mx6:mx6ul:"

PREFERRED_PROVIDER_virtual/kernel ?= "linux-turing"

UBOOT_MAKE_TARGET = ""
UBOOT_SUFFIX = "img"
UBOOT_CONFIG ??= "sd"
UBOOT_CONFIG[sd] = "mx6ulturing_defconfig,sdcard"
UBOOT_CONFIG[nand] = "mx6ulturing_defconfig,ubi"
SPL_BINARY = "SPL"
PREFERRED_PROVIDER_u-boot ?= "u-boot-turing"
PREFERRED_PROVIDER_virtual/bootloader ?= "u-boot-turing"

KERNEL_IMAGETYPE = "zImage"
KERNEL_DEVICETREE = "imx6ul-turing-eval.dtb imx6ull-turing-eval.dtb"

MACHINE_FEATURES += "apm usbgadget usbhost vfat alsa touchscreen screen wifi bluetooth serial keyboard"

SERIAL_CONSOLE = "115200 ttymxc3"

## Parameters for NAND IC MT29F32G08CBADBWP-12:D

MKUBIFS_ARGS = "--min-io-size 8192 --leb-size 2080768 --max-leb-cnt 2022"
UBINIZE_ARGS = "--min-io-size 8192 --peb-size 2097152 --sub-page-size 8192"

## To determine parameters' values, run "ubiattach -m 0 /dev/ubi_ctrl"
## (assuming the rootfs device is /dev/mtd0).  Here's an example:

# # ubiattach -m 8 /dev/ubi_ctrl
# ubi0: attaching mtd8
# ubi0: scanning is finished
# ubi0: empty MTD device detected
# ubi0: attached mtd8 (name "rootfs", size 4062 MiB)
# ubi0: PEB size: 2097152 bytes (2048 KiB), LEB size: 2080768 bytes
# ubi0: min./max. I/O unit sizes: 8192/8192, sub-page size 8192
# ubi0: VID header offset: 8192 (aligned 8192), data offset: 16384
# ubi0: good PEBs: 2022, bad PEBs: 9, corrupted PEBs: 0
# ubi0: user volume: 0, internal volumes: 1, max. volumes count: 128
# ubi0: max/mean erase counter: 0/0, WL threshold: 4096, image sequence number: 1507147450
# ubi0: available PEBs: 1987, total reserved PEBs: 35, PEBs reserved for bad PEB handling: 31
# ubi0: background thread "ubi_bgt0d" started, PID 379
# UBI device number 0, total 2022 LEBs (4207312896 bytes, 3.9 GiB), available 1987 LEBs (4134486016 bytes, 3.9 GiB), LEB size 2080768 bytes (2.0 MiB)



# --min-io-size: see "min./max. I/O unit sizes: " in the ubiattach output
# --leb-size: see "LEB size:" in the ubiattach output
# --max-leb-cnt: see "total <n> LEBs" in the ubiattach output, where <n> is the number you want
# --peb-size: see "PEB size:" in the ubiattach output (pick the value in bytes)
# --sub-page-size: see "sub-page size" in the ubiattach output
```

## conf/machine/imx6x-turing-smart.conf
```bitbake
#@TYPE: Machine
#@NAME: Turing i.MX6x Evaluation Board (SMART Variant)
#@SOC: i.MX6 Q/DL
#@DESCRIPTION: Machine configuration for Turing Computer i.MX6 Evaluation Boards (SMART Variants)
#@MAINTAINER: Mauricio Cirelli <mauricio@turingcomputer.com.br>

# Machine config for the Turing Computer i.MX6 Evaluation Board machines (SMART Variants).
# They all use the same machine config, since the u-boot SPL autodetects the
# machine type upon booting. SOC_FAMILY includes all SoCs from all of these machines
# to let recipes include firmware etc. for all of these SoCs.
# This builds for SMART Variants, which means that
# there will be reduced DDR3 for Quad (1GB) and Dual Lite (512MB) versions.

require conf/machine/include/imx-base.inc
require conf/machine/include/tune-cortexa9.inc

SOC_FAMILY = "mx6:mx6dl:mx6q"

PREFERRED_PROVIDER_virtual/kernel ?= "linux-turing"

UBOOT_MAKE_TARGET = ""
UBOOT_SUFFIX = "img"
UBOOT_CONFIG ??= "sd"
UBOOT_CONFIG[sd] = "mx6turing_smart_defconfig,sdcard"
SPL_BINARY = "SPL"
PREFERRED_PROVIDER_u-boot ?= "u-boot-turing"
PREFERRED_PROVIDER_virtual/bootloader ?= "u-boot-turing"

KERNEL_IMAGETYPE = "zImage"
KERNEL_DEVICETREE = "imx6dl-turing-eval.dtb imx6q-turing-eval.dtb"

MACHINE_FEATURES += "apm usbgadget usbhost vfat alsa touchscreen screen wifi bluetooth serial keyboard"

SERIAL_CONSOLE = "115200 ttymxc4"

# 16MB Boot Partition
BOOT_SPACE = "16384"
```

## conf/machine/imx6x-turing.conf
```bitbake
#@TYPE: Machine
#@NAME: Turing i.MX6x Evaluation Board
#@SOC: i.MX6 Q/DL
#@DESCRIPTION: Machine configuration for Turing Computer i.MX6 Evaluation Boards
#@MAINTAINER: Mauricio Cirelli <mauricio@turingcomputer.com.br>

# Machine config for the Turing Computer i.MX6 Evaluation Board machines.
# They all use the same machine config, since the u-boot SPL autodetects the
# machine type upon booting. SOC_FAMILY includes all SoCs from all of these machines
# to let recipes include firmware etc. for all of these SoCs.

require conf/machine/include/imx-base.inc
require conf/machine/include/tune-cortexa9.inc

SOC_FAMILY = "mx6:mx6dl:mx6q:"
MACHINEOVERRIDES =. "mx6:mx6q:m6dl:"

PREFERRED_PROVIDER_virtual/kernel ?= "linux-turing"

UBOOT_MAKE_TARGET = ""
UBOOT_SUFFIX = "img"
UBOOT_CONFIG ??= "sd"
UBOOT_CONFIG[sd] = "mx6turing_defconfig,sdcard"
SPL_BINARY = "SPL"
PREFERRED_PROVIDER_u-boot ?= "u-boot-turing"
PREFERRED_PROVIDER_virtual/bootloader ?= "u-boot-turing"

KERNEL_IMAGETYPE = "zImage"
KERNEL_DEVICETREE = "imx6dl-turing-eval.dtb imx6q-turing-eval.dtb"

MACHINE_FEATURES += "apm usbgadget usbhost vfat alsa touchscreen screen wifi bluetooth serial keyboard"

SERIAL_CONSOLE = "115200 ttymxc4"
```
